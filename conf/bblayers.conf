## conf/bblayers.conf
```bitbake
# LAYER_CONF_VERSION is increased each time build/conf/bblayers.conf
# changes incompatibly
LCONF_VERSION = "6"

BBPATH = "${TOPDIR}"
BBFILES ?= ""

BBLAYERS ?= " \
  /home/builder/git/poky/meta \
  /home/builder/git/poky/meta-yocto \
  /home/builder/git/poky/meta-yocto-bsp \
  /home/builder/git/oe-core/meta \
  /home/builder/git/meta-qt5 \
  /home/builder/git/meta-openembedded/meta-networking \
  /home/builder/git/meta-openembedded/meta-python \
  /home/builder/git/meta-openembedded/meta-oe \
  "
BBLAYERS_NON_REMOVABLE ?= " \
  /home/builder/git/poky/meta \
  /home/builder/git/poky/meta-yocto \
  "
#added by hob
BBFILES += "${TOPDIR}/recipes/images/custom/*.bb"
#added by hob
BBFILES += "${TOPDIR}/recipes/images/*.bb"
```
